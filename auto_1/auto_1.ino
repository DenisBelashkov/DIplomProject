#include <IRremote.h> 
#include <SPI.h> 
#include <Wire.h> 
#include <Adafruit_GFX.h> 
#include <Adafruit_SSD1306.h> 
#include <dht.h> 


#define SSD1306_LCDHEIGHT 64 
#define DHT11_PIN 13 

dht DHT; 

#define Desired_temperature 27 


unsigned int ACoff[] = {2950,1750, 400,1100, 450,1050, 450,400, 400,400, 400,400, 450,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1100, 450};  

unsigned int ACon[] = {2950,1700, 450,1100, 400,1100, 450,350, 450,350, 450,400, 450,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400, 450};

unsigned int Temp23[] = {3000,1650, 550,950, 550,1000, 500,300, 550,250, 550,250, 550,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400, 450};  

unsigned int Temp24[] = {3000,1650, 500,1050, 500,1000, 500,300, 500,300, 500,350, 500,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350, 550};  

unsigned int Temp25[] = {3050,1650, 500,1000, 550,950, 550,300, 500,300, 500,300, 550,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300, 550};  

unsigned int Temp26[] = {3000,1650, 500,1000, 500,1050, 500,300, 500,300, 500,350, 500,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350, 500};  

unsigned int Temp27[] = {3050,1600, 550,1000, 500,1000, 550,300, 500,300, 550,250, 550,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350, 500};  // PANASONIC C4D3:64800024

unsigned int Temp28[] = {3100,1600, 550,950, 550,1000, 550,250, 550,250, 550,250, 550,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300, 550};  

unsigned int Temp29[] = {3100,1550, 600,950, 500,1000, 550,300, 500,300, 500,300, 550,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300, 500};  

unsigned int Temp30[] = {3000,1650, 500,1000, 550,1000, 500,300, 500,300, 550,250, 550,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300, 500};  


IRsend irsend;

int Measured_temp;

int Measured_Humi;

int AC_Temp;

char temp_error = 2;

int Pev_value;

boolean AC = false;


int khz = 38; 


void setup()


void loop() {


  DHT.read11(DHT11_PIN); 

  Measured_temp = DHT.temperature + temp_error;

  Measured_Humi = DHT.humidity;


 if ((Measured_temp <= (Desired_temperature-3)) && AC == true) 

 {

  irsend.sendRaw(ACoff, sizeof(ACoff) / sizeof(ACoff[0]), khz);  delay(2000);

  AC_Temp = 0; 
  
  AC=false;

 }


 if ((Measured_temp >= Desired_temperature+4) && AC == false)

 {

  irsend.sendRaw(ACon, sizeof(ACon) / sizeof(ACon[0]), khz); delay(2000);

  delay(2000);

  irsend.sendRaw(Temp27, sizeof(Temp27) / sizeof(Temp27[0]), khz); 

  AC_Temp = 27;

  AC=true;

 }


if ( Measured_temp != Pev_value) 

{


if (Measured_temp == Desired_temperature+3)

{

   irsend.sendRaw(Temp24, sizeof(Temp24) / sizeof(Temp24[0]), khz); delay(2000);

  AC_Temp = 24; 

}


if (Measured_temp == Desired_temperature+2) 

{

   irsend.sendRaw(Temp25, sizeof(Temp25) / sizeof(Temp25[0]), khz); delay(2000);

  AC_Temp = 25; 

}


if (Measured_temp == Desired_temperature+1) 

{

   irsend.sendRaw(Temp26, sizeof(Temp26) / sizeof(Temp26[0]), khz); delay(2000);

  AC_Temp = 26; 

}


if (Measured_temp == 27 ) 

{

  irsend.sendRaw(Temp27, sizeof(Temp27) / sizeof(Temp27[0]), khz);

  AC_Temp = 27; 

}


if (Measured_temp == Desired_temperature-1) 

{

  irsend.sendRaw(Temp28, sizeof(Temp28) / sizeof(Temp28[0]), khz); delay(2000);

  AC_Temp = 28; 

}


if (Measured_temp == Desired_temperature-2 ) 

{

  irsend.sendRaw(Temp29, sizeof(Temp29) / sizeof(Temp29[0]), khz); delay(2000);

  AC_Temp = 29; 

}


if (Measured_temp == Desired_temperature-3 ) 

{

  irsend.sendRaw(Temp30, sizeof(Temp30) / sizeof(Temp30[0]), khz); delay(2000);

  AC_Temp = 30; 

}


}

Pev_value = Measured_temp;

}
